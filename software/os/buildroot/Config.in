## software/os/buildroot/Config.in
```kconfig
menu "KVMPanel packages"
source "$BR2_EXTERNAL_KVMPANEL_PATH/package/kvmd/Config.in"
source "$BR2_EXTERNAL_KVMPANEL_PATH/package/kvmpanel-amp/Config.in"
source "$BR2_EXTERNAL_KVMPANEL_PATH/package/kvmpanel-stc-power/Config.in"
endmenu
```

## software/os/buildroot/configs/kvmpanel_defconfig
```kconfig
BR2_arm=y
BR2_cortex_a7=y
BR2_ARM_EABIHF=y
BR2_TOOLCHAIN_EXTERNAL=y
BR2_TOOLCHAIN_EXTERNAL_BOOTLIN=y
BR2_TOOLCHAIN_EXTERNAL_BOOTLIN_ARMV7_EABIHF_MUSL_STABLE=y
BR2_STATIC_LIBS=y
BR2_TARGET_GENERIC_HOSTNAME="kvmpanel"
BR2_TARGET_GENERIC_ISSUE="KVMPanel"
BR2_TARGET_ROOTFS_CPIO=y
BR2_TARGET_ROOTFS_CPIO_GZIP=y
# BR2_TARGET_ROOTFS_TAR is not set
BR2_ARM_FPU_NEON_VFPV4=y
BR2_PACKAGE_JPEG=y
BR2_PACKAGE_JPEG_TURBO=y
BR2_PACKAGE_JPEG_TURBO_TOOLS=y
BR2_PACKAGE_BUSYBOX_SHOW_OTHERS=y
BR2_PACKAGE_EVTEST=y
BR2_PACKAGE_I2C_TOOLS=y
BR2_PACKAGE_LIBGPIOD=y
BR2_PACKAGE_LIBGPIOD_TOOLS=y
BR2_PACKAGE_LIBV4L=y
BR2_PACKAGE_LIBV4L_UTILS=y
BR2_ROOTFS_OVERLAY="$(BR2_EXTERNAL_KVMPANEL_PATH)/board/kvmpanel/rootfs-overlay"
BR2_PACKAGE_KVMD=y
BR2_PACKAGE_LIBCURL=y
BR2_PACKAGE_LIBCURL_CURL=y
# BR2_PACKAGE_MDNSD_SSH_SERVICE is not set
```

## software/os/buildroot/package/kvmd/Config.in
```kconfig
config BR2_PACKAGE_KVMD
	bool "kvmd"
	depends on BR2_cortex_a7 && BR2_ARM_EABIHF && BR2_TOOLCHAIN_USES_MUSL
	depends on !BR2_SHARED_LIBS # static libturbojpeg
	depends on BR2_TOOLCHAIN_HEADERS_AT_LEAST_4_8 && BR2_TOOLCHAIN_GCC_AT_LEAST_4_8
	depends on BR2_TOOLCHAIN_HAS_THREADS && BR2_INSTALL_LIBSTDCPP
	select BR2_PACKAGE_DROPBEAR
	select BR2_PACKAGE_MDNSD
	select BR2_PACKAGE_LIBV4L
	select BR2_PACKAGE_LIBV4L_UTILS
	select BR2_PACKAGE_JPEG
	select BR2_PACKAGE_JPEG_TURBO
	select BR2_PACKAGE_LIBGPIOD
	select BR2_PACKAGE_LIBGPIOD_TOOLS
	help
	  KVMPanel HTTP, WebSocket and panel-socket service. The host needs
	  Rust stable and the armv7-unknown-linux-musleabihf standard library.
```

## software/os/buildroot/package/kvmpanel-amp/Config.in
```kconfig
config BR2_PACKAGE_KVMPANEL_AMP
	bool "KVMPanel C906 loopback and HiFi4 USB audio firmware"
	help
	  Build T113-i remoteproc firmware for the C906 echo, HiFi4 USB
	  microphone bridge and RPMsg diagnostics.
	  Set RISCV_CROSS_COMPILE and XTENSA_CROSS_COMPILE if the
	  default cross-compiler prefixes are not on PATH.
```

## software/os/buildroot/package/kvmpanel-stc-power/Config.in
```kconfig
config BR2_PACKAGE_KVMPANEL_STC_POWER
	bool "KVMPanel STC power"
	depends on BR2_INIT_BUSYBOX
	help
	  Native UART power control and STC8G1K08A factory ISP updater.
	  The KVMPanel BusyBox and Linux patches provide normal poweroff.
```

## software/os/u-boot/configs/kvmpanel_fel_defconfig
```kconfig
CONFIG_ARM=y
CONFIG_ARCH_SUNXI=y
CONFIG_DEFAULT_DEVICE_TREE="allwinner/sun8i-t113i-kvmpanel"
CONFIG_SPL=y
CONFIG_MACH_SUN8I_R528=y
CONFIG_DRAM_CLK=792
CONFIG_DRAM_ZQ=8092667
CONFIG_DRAM_SUNXI_ODT_EN=0x1
CONFIG_DRAM_SUNXI_TPR0=0x004a2195
CONFIG_DRAM_SUNXI_TPR11=0x00770000
CONFIG_DRAM_SUNXI_TPR12=0x00000002
CONFIG_DRAM_SUNXI_TPR13=0x34050100
CONFIG_CONS_INDEX=1
CONFIG_CMD_BOOTZ=y
CONFIG_ENV_IS_NOWHERE=y
```
